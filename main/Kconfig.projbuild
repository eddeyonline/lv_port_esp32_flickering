## main/Kconfig.projbuild
```kconfig
menu "Project Configuration"

    config ESP_AP_WIFI_SSID
        string "WiFi AP Mode SSID"
	default "myssid"
        help
            Your WiFi SSID
    
    config ESP_AP_WIFI_PASSWORD
        string "WiFi AP Mode password"
	default "mypassword"
        help
            Your WiFi password
    
    config ESP_AP_MAX_STA_CONN
        int "WiFi AP Mode max retry"
	default 5
        help
            Max retry
    
    config ESP_WIFI_SSID
        string "WiFi SSID"
	default "myssid"
        help
            Your WiFi SSID
    
    config ESP_WIFI_PASSWORD
        string "WiFi password"
	default "mypassword"
        help
            Your WiFi password

endmenu
```
